## config/boards/shields/ws_nice_view/Kconfig.shield
```kconfig
# Copyright (c) 2026 wskozel
# SPDX-License-Identifier: MIT

config SHIELD_WS_NICE_VIEW
    def_bool $(shields_list_contains,ws_nice_view)
```
